## boards/arm/vault35_ble/Kconfig.board
```kconfig
# Copyright (c) 2024 Brandon Beltran
# SPDX-License-Identifier: MIT

config BOARD_VAULT35_BLE
	bool "vault35"
	depends on SOC_NRF52840_QIAA
```

## boards/arm/vault35_ble/Kconfig.defconfig
```kconfig
# Copyright (c) 2024 Brandon Beltran
# SPDX-License-Identifier: MIT

if BOARD_VAULT35_BLE

config ZMK_KEYBOARD_NAME
    default "Vault35 BLE"

config BT_CTLR
    default BT

endif # BOARD_VAULT35_BLE
```
